## firmware/main/Kconfig.projbuild
```kconfig
menu "Self-involving M3"

config M3_WIFI_SSID
    string "Fallback Wi-Fi SSID"
    default ""

config M3_WIFI_PASSWORD
    string "Fallback Wi-Fi password"
    default ""

config M3_GATEWAY_URI
    string "Cognition gateway WebSocket URI"
    default ""
    help
        Use a TLS URI such as wss://voice.example.com/v1/device.

config M3_DEVICE_TOKEN
    string "Revocable device token"
    default ""
    help
        This is a per-device gateway credential, never a model-provider API key.

config M3_OUTPUT_VOLUME
    int "Speaker volume"
    range 0 70
    default 45

endmenu
```

## firmware/sdkconfig.defaults
```kconfig
CONFIG_IDF_TARGET_ESP32S3=y
CONFIG_ESPTOOLPY_FLASHSIZE_16MB=y
CONFIG_PARTITION_TABLE_CUSTOM=y
CONFIG_PARTITION_TABLE_CUSTOM_FILENAME="partitions.csv"

CONFIG_SPIRAM=y
CONFIG_SPIRAM_MODE_OCT=y
CONFIG_SPIRAM_SPEED_80M=y
CONFIG_SPIRAM_USE_MALLOC=y
CONFIG_SPIRAM_TRY_ALLOCATE_WIFI_LWIP=y

CONFIG_FREERTOS_HZ=1000
CONFIG_ESP_CONSOLE_USB_SERIAL_JTAG=y
CONFIG_ESP_SYSTEM_PANIC_PRINT_REBOOT=y
CONFIG_ESP_TASK_WDT_EN=y
CONFIG_BOOTLOADER_APP_ROLLBACK_ENABLE=y

CONFIG_LOG_DEFAULT_LEVEL_INFO=y
CONFIG_COMPILER_CXX_EXCEPTIONS=n
CONFIG_COMPILER_CXX_RTTI=n
```
